/*
 * conditioner_bootloader.c
 *
 *  Created on: 01.02.2016
 *      Author: stefan
 */

#include "system.h"
#include <stdio.h>
#include <unistd.h>
#include "alt_types.h"
#include "sys/alt_irq.h"
#include "altera_avalon_timer.h"
#include "altera_avalon_timer_regs.h"
#include "altera_avalon_pio_regs.h"
#include "sys/alt_stdio.h"
#include "system.h"
#include "io.h"
#include "sys/alt_alarm.h"
#include "timer.h"
#include "trprintf.h"
#include "altera_avalon_uart.h"
#include "altera_avalon_uart_fd.h"
#include "altera_avalon_uart_regs.h"
#include "rx_ink_common.h"
#include "nios_def_head.h"
#include "uart.h"
#include "main.h"
#include "conditioner_bootloader.h"
#include "crc_calc.h"


//--- GPIO Pins ------------------------
#define MCU_RESET			0b0001
#define MCU_BOOT			0b0010
#define MCU_BOOTLOADER		0b0100
#define MCU_RESERVE			0b1000

#define  FLASH_BLK_SIZE		512

#define FOR_ALL_COND	for(i=0; i<MAX_HEADS_BOARD; i++)
#define FOR_ALL_ACTIVE_COND	for(i=0; i<MAX_HEADS_BOARD; i++) if (*pCondNo & (1<<i))

// #define TRACE

//Prototype

//  cond0_reserve       <= cond0_pio(3);
//  cond0_oe_bootloader <= cond0_pio(2);
//  cond0_boot_uc       <= cond0_pio(1);
//  cond0_reset_uc      <= cond0_pio(0);

//reset value 0x00000001 => reset =1;

//The communication baud rate is 9600[bps] when built-in high-speed CR oscillator is used
//External Osc. Source Oscillating Frequency 4MHz , Communication Baud Rate 9600bps
//=> 9600 bit per second => 50kb binary ~ 53'248 Bytes => 425'984 bit = 45s Programmierung !
// 115200 bit/sec => 4s programmierung => external 48MHz Quarz notwendig!

// oe_bootloader = 1;
// Boot_uC = 1;

//optimiert level 3 = 40'960 Bytes = 327'680 bit => 34s@9600 => 3s@115200
//optimiert level 3 & microlib = 36'864 Bytes = 294'912 bit => 31s@9600 => 3s@115200
//optimiert level 3 & microlib & cross module optimation =20'480 Bytes = 163840 bit => 17s@9600 => 1.5s@115200
//optimiert level 0 = 53'248 Bytes = 425'984 bit => 45s@9600 => 4s@115200


// danach RESET =1;

#pragma pack(1)

typedef struct
{
	UCHAR   cmd;
	UINT32 addr;
} SFlashCmd;

typedef struct
{
	UCHAR data[FLASH_BLK_SIZE];
	UCHAR crc_high;
	UCHAR crc_low;
} SFlashData;
#pragma pack()

typedef struct
{
	int 	   pos;
	SFlashData data;
} SConditionerData;

UCHAR ram_kernel_prepare []={0x00, 0x00, 0xe9, 0x03, 0x20, 0x20, 0x08, 0x00, 0x00, 0x34};
UCHAR ram_kernel[]={0x00,0xF0,0x00,0xB8,0x00,0xE0,0x00,0x01,0x4F,0xF2,0x00,0x20,0xC2,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0x39,0xB3};
UCHAR jump_to_ram[]={0xC0, 0x00, 0x00, 0x00, 0x00, 0x00, 0x00, 0x00, 0x00, 0xC0};
UCHAR erase_cr_data_read[]={0x39, 0x00, 0x00, 0x00, 0x00};
UCHAR cr_trimming_mirror_data[]={0x00, 0x00, 0x00, 0x00, 0x00, 0x00, 0x00, 0x00,};
UCHAR chip_erase[]={0x38, 0xFF, 0xFF, 0x03, 0x00};
UCHAR blank_check_0[]={0x48, 0x00, 0x00, 0x00, 0x00};
UCHAR blank_check_1[]={0xFF, 0xFF, 0x03, 0x00};

static void _write_data(int *pCondNo, UCHAR *data, int size, char response, int tio);
static void _read_block(int *pCondNo, int tio);
static void _set_out(int data);
static void _set_state(EnDownloadState state, int condNo);

static void _send_ram_kernel(int *pCondNo);
static void _read_last_block(int *pCondNo);
static void _read_user_flash(int *pCondNo);
static void _write_user_flash(int *pCondNo);
static void _erase_and_check(int *pCondNo);
static void _program_flash	(int *pCondNo);

static SConditionerData _Cond[MAX_HEADS_BOARD];
static SFlashData		_ProgramData;
static int				_Running=0;

//--- bootloader_running ------------------
int	bootloader_running(void)
{
	return _Running!=0;
}

//--- bootloader_start ---------------------------------
void bootloader_start(void)
{
	int		condNo   = 0x0f;
	int  	*pCondNo = &condNo;
	int 	i;
	UCHAR data_out;

	pRX_Status->condDnlBlkAddr = pRX_Config->exe.blkAddr;

	_Running = TRUE;
	_set_state(dnl_start, condNo);

#ifdef TRACE
	trprintf("Download Conditioner[%d]\n", condNo);
#endif

//	pRX_Config->cond[condNo].backup_pump_minutes = pRX_Status->cond[condNo].pump_minutes;

	_send_ram_kernel(&condNo);
	if (!condNo) goto restart;

	#ifdef TRACE
		trprintf("Set Baudrate to 115200\n");
	#endif

	FOR_ALL_COND uart_set_baudrate(i, divisor_115200_baud);

	timer_sleep(100);
	#ifdef TRACE
		trprintf("start_bootloader 3: send 0xe8\n");
	#endif
	{
		int no;
		for (i=0; i<10; i++)
		{
			#ifdef TRACE
				trprintf("%d: _send 0x18\n", timer_getTick());
			#endif
			data_out = 0xE8;
			no = *pCondNo;
			_write_data(&condNo, &data_out, 1, 0x31, 100);
			if (no==*pCondNo) break;
		}
	}
	if (!condNo) goto restart;

	timer_sleep(200);

	FOR_ALL_COND memset(&_Cond[i].data, 0, sizeof(_Cond[i].data));

	_read_last_block(&condNo);
	if (!condNo) goto restart;

	FOR_ALL_ACTIVE_COND
	{
		/*
		int n;
		for (n=0; n<512; n++)
		{
			printf("%03d:  %02x/%c  %02x/%c\n", n, pRX_Config->exe.blkData[n], pRX_Config->exe.blkData[n], _Cond[i].data.data[n], _Cond[i].data.data[n]);
		}
		printf("addr=0x%04x 0x%04x memcmp=%d\n",  pRX_Config->exe.blkAddr, pRX_Status->condDnlBlkAddr, memcmp(_Cond[i].data.data, pRX_Config->exe.blkData, FLASH_BLK_SIZE));
		*/
		if (!memcmp(_Cond[i].data.data, pRX_Config->exe.blkData, FLASH_BLK_SIZE))
		{
			#ifdef TRACE
				trprintf("Conditioner[%d] up to date\n", i);
			#endif
			condNo &= ~(1<<i);
		}
	}
	if (!condNo) goto restart;

	_read_user_flash(&condNo);
	_erase_and_check(&condNo);
	_program_flash(&condNo);
	_write_user_flash(&condNo);

restart:
	//--- restart ---------------------------
	condNo = 0x0f;
	_set_state(dnl_mcu_reset2, condNo);

//	_set_out(MCU_BOOTLOADER | MCU_RESET);	// active now
	main_rebooting_cond();
	_set_out(MCU_BOOTLOADER);              	//reserve=0, oe_bootloader=1; boot_uc=0, reset=0	//reset uc
	timer_sleep(200);
	_set_out(MCU_BOOTLOADER | MCU_RESET);
	_set_out(                 MCU_RESET);

	timer_sleep(100);

	//--- restart uart ----------------------------
	FOR_ALL_COND uart_set_baudrate(i, divisor_115200_baud);

	_set_state(dnl_done, condNo);
	_Running = FALSE;
	#ifdef TRACE
		trprintf("bootloader END\n");
	#endif
}

//--- _send_ram_kernel -----------------------------------------------
static void _send_ram_kernel (int *pCondNo)
{
	int 	i;
	UCHAR	data_out;

	_set_state(dnl_reset, *pCondNo);
	#ifdef TRACE
		trprintf("dnl_reset\n");
	#endif

//	_set_out(MCU_BOOTLOADER);
//	_set_out(MCU_BOOTLOADER); // | 			 MCU_RESET);
//	_set_out(MCU_BOOTLOADER | MCU_BOOT | MCU_RESET);

	_set_out(MCU_BOOTLOADER | MCU_BOOT 			 );
	timer_sleep(500);
	_set_out(MCU_BOOTLOADER | MCU_BOOT | MCU_RESET);
	timer_sleep(100);

	FOR_ALL_COND uart_set_baudrate(i, divisor_9600_baud);
	timer_sleep(100);

	int condNo;
	for (i=0; i<10; i++)
	{
		#ifdef TRACE
			trprintf("%d: _send 0x18\n", timer_getTick());
		#endif
		data_out = 0x18;
		condNo = *pCondNo;
		_write_data(&condNo, &data_out, 1, 0x11, 100);
		if (condNo==*pCondNo) break;
	}

	if (condNo==0) return;

	_set_state(dnl_send_ram_kernel, *pCondNo);

	#ifdef TRACE
		trprintf("dnl_send_ram_kernel prepare\n");
	#endif

	_write_data(pCondNo, ram_kernel_prepare, sizeof(ram_kernel_prepare), 0x01, 2000);

	#ifdef TRACE
		trprintf("dnl_send_ram_kernel\n");
	#endif
	_write_data(pCondNo, ram_kernel, sizeof(ram_kernel), 0x01, 1000);

	if (*pCondNo==0) return;

	_set_state(dnl_start_ram_kernel, *pCondNo);
	#ifdef TRACE
		trprintf("send 0x18\n");
	#endif
	for (i=0; i<10; i++)
	{
		#ifdef TRACE
			trprintf("%d: _send 0x18\n", timer_getTick());
		#endif
		data_out = 0x18;
		condNo = *pCondNo;
		_write_data(&condNo, &data_out, 1, 0x11, 100);
		if (condNo==*pCondNo) break;
	}
	if (*pCondNo==0) return;

	#ifdef TRACE
		trprintf("jump_to_ram\n");
	#endif
	_write_data(pCondNo, jump_to_ram, sizeof(jump_to_ram), 0x31, 2000);
}

//--- _erase_and_check --------------------------------
static void _erase_and_check(int *pCondNo)
{
	_set_state(dnl_chip_erase, *pCondNo);
	_write_data(pCondNo, chip_erase, sizeof(chip_erase), 0x31, 20000);
	
	_set_state(dnl_blank_check, *pCondNo);
	_write_data(pCondNo, blank_check_0, sizeof(blank_check_0), 0x30, 2000);
	_write_data(pCondNo, blank_check_1, sizeof(blank_check_1), 0x31, 2000);
}

//--- _read_last_block -------------------------------------------
static void _read_last_block(int *pCondNo)
{
	SFlashCmd  cmd;

	#ifdef TRACE
		trprintf("READ Last Flash Block\n");
	#endif

	cmd.cmd	 = 0x28;	// read command
	cmd.addr = pRX_Config->exe.blkAddr;
	_write_data(pCondNo, (UCHAR*)&cmd, sizeof(cmd), 0x31, 500);
	_read_block(pCondNo, 200);
}

//--- _read_user_flash --------------------------
static void _read_user_flash(int *pCondNo)
{
	SFlashCmd  cmd;

	#ifdef TRACE
		trprintf("Read User Flash\n");
	#endif
	cmd.cmd	 = 0x28;	// read command
	cmd.addr = CONDITIONER_FLASH_USER_ADDR;
	_write_data(pCondNo, (UCHAR*)&cmd, sizeof(cmd), 0x31, 500);
	_read_block(pCondNo, 200);
}

//--- _write_user_flash -------
static void _write_user_flash(int *pCondNo)
{
	int i, n;
	SFlashCmd  cmd;

	#ifdef TRACE
		trprintf("Write User Flash\n");
	#endif

	for (i=0; i<MAX_HEADS_BOARD; i++)
	{
		if (*pCondNo && (1<<i))
		{
			cmd.cmd  = 0x08; // write command
			cmd.addr = CONDITIONER_FLASH_USER_ADDR;
			n = 1<<i;
			_write_data(&n, (UCHAR*)&cmd, sizeof(cmd), 0x31, 200);
			_write_data(&n, (UCHAR*)&_Cond[i].data, sizeof(_Cond[i].data), 0x31, 500);
		}
	}
}

//--- _program_flash ----------------------------------------------
static void _program_flash(int *pCondNo)
{
	int end;
	SFlashCmd  cmd;
	unsigned short crc;

	_set_state(dnl_write_binary, *pCondNo);

	cmd.cmd  = 0x08; // write command
	pRX_Status->condDnlBlkAddr = 0;

	for(cmd.addr=0; cmd.addr<pRX_Config->exe.size; cmd.addr+=FLASH_BLK_SIZE)
	{
		end = timer_getTick()+500;
		while (pRX_Config->exe.blkAddr!=cmd.addr)
		{
			if (timer_getTick()>end)
			{
				int i;
				for(i=0; i<MAX_HEADS_BOARD; i++)
				{
					#ifdef TRACE
						trprintf("%d: cond[%d]: timeout\n", timer_getTick(), 0);
					#endif
					pRX_Status->cond[i].error |= COND_ERR_download;
					*pCondNo &= ~(1<<i);
				}
				return;
			}
			timer_sleep(1);
		}
		memcpy(_ProgramData.data, &pRX_Config->exe.blkData, FLASH_BLK_SIZE);
		pRX_Status->condDnlBlkAddr += FLASH_BLK_SIZE;
		crc=crc_calc((char*)_ProgramData.data, FLASH_BLK_SIZE);
		_ProgramData.crc_low  = (crc&0xff);
		_ProgramData.crc_high = (crc&0xff00)>>8;

		#ifdef TRACE
			trprintf("program_flash: Addr=%d, crc=0x%04x\n", cmd.addr, crc);
		#endif
		_write_data(pCondNo, (UCHAR*)&cmd, sizeof(cmd), 0x31, 200);

		#ifdef TRACE
			trprintf("program_flash: Write Data\n");
		#endif
		_write_data(pCondNo, (UCHAR*)&_ProgramData, sizeof(_ProgramData), 0x31, 500);
	}
}

//--- _write_data --------------------------------------
static void _write_data(int *pCondNo, UCHAR *data, int size, char response, int tio)
{
	int done=0;
	int i, n;
	int end;
	UCHAR data_in;

	FOR_ALL_ACTIVE_COND
	{
		for(n=0; n<size; n++)
		{
			while (!uart_write_byte(i, data[n]));
		}
	}

	FOR_ALL_ACTIVE_COND
	{
		uart_wait_sent(i);
	}
	timer_sleep(10);
	end = timer_getTick()+tio;

	while(done!=*pCondNo)
	{
		for(i=0; i<MAX_HEADS_BOARD; i++)
		{
			if ((*pCondNo&(1<<i))&& !(done&(1<<i)))
			{
				if (timer_getTick()>end)
				{
					#ifdef TRACE
						trprintf("%d: cond[%d]: timeout\n", timer_getTick(), i);
					#endif
					pRX_Status->cond[i].error |= COND_ERR_download;
					*pCondNo &= ~(1<<i);
				}
				else if (uart_read(i, &data_in))
				{
					#ifdef TRACE
						trprintf("cond[%d]: data_in =0x%x\n", i, data_in);
					#endif

					if (data_in==response)
					{
						#ifdef TRACE
							trprintf("cond[%d]: OK\n", i);
						#endif
						done |= (1<<i);
					}
					else
					{
						switch (data_in)
						{
						case 0x30:	break;	// busy
						case 0x31:
									#ifdef TRACE
										trprintf("cond[%d]: OK\n", i);
									#endif
									done |= (1<<i);
									break;

						case 0x32:
									#ifdef TRACE
										trprintf("cond[%d]: ERROR blank check\n", i);
									#endif
										pRX_Status->cond[i].error |= COND_ERR_download;
									*pCondNo &= ~(1<<i);
									break;

						case 0x34:
									#ifdef TRACE
										trprintf("cond[%d]: ERROR write\n", i);
									#endif
										pRX_Status->cond[i].error |= COND_ERR_download;
									*pCondNo &= ~(1<<i);
									break;

						case 0x35:
									#ifdef TRACE
										trprintf("cond[%d]: ERROR crc\n", i);
									#endif
										pRX_Status->cond[i].error |= COND_ERR_download;
									*pCondNo &= ~(1<<i);
									break;
						}
					}
				}
			}
		}
	}
}

//--- _read_block --------------------------------------
static void _read_block(int *pCondNo, int tio)
{
	int done=0;
	int i;
	int end;
	UCHAR data_in;

	end = timer_getTick()+tio;

	for (i=0; i<MAX_HEADS_BOARD; i++) _Cond[i].pos=0;

	//--- read back data block --------------------
	while(done!=*pCondNo)
	{
		for(i=0; i<MAX_HEADS_BOARD; i++)
		{
			if ((*pCondNo&(1<<i)) && !(done&(1<<i)))
			{
				if (timer_getTick()>end)
				{
					#ifdef TRACE
						trprintf("%d: cond[%d].TIMEOUT: Received %d bytes\n", timer_getTick(), i, _Cond[i].pos);
					#endif
					pRX_Status->cond[i].error |= COND_ERR_download;
					*pCondNo &= ~(1<<i);
				}
				else if (uart_read(i, &data_in))
				{
					_Cond[i].data.data[_Cond[i].pos] = data_in;
					if (++_Cond[i].pos>FLASH_BLK_SIZE+2)
					{
						#ifdef TRACE
							trprintf("cond[%d]: Received %d Bytes\n", i, _Cond[i].pos);
						#endif
						done |= (1<<i);
					}
				}
			}
		}
	}
}

//--- _set_out -------------------------------
static void _set_out(int data)
{
	int condNo;

	static int 	_pio_base[4]={COND_PIO_0_BASE, COND_PIO_1_BASE, COND_PIO_2_BASE, COND_PIO_3_BASE};
	for (condNo=0; condNo<MAX_HEADS_BOARD; condNo++)
	{
		IOWR_ALTERA_AVALON_PIO_DATA(_pio_base[condNo], data);
	}
}

//--- _set_state ----------------------------------------------------
static void _set_state(EnDownloadState state, int condNo)
{
	pRX_Status->condDnlState = state;
	pRX_Status->condDnlNo    = condNo;

	#ifdef TRACE
		trprintf("cond[%01x]: %s\n", condNo, DownloadStateStr(state));
	#endif
}

